## CMakeLists.txt
```
#
# Copyright (c) 2018 Nordic Semiconductor
#
# SPDX-License-Identifier: LicenseRef-Nordic-5-Clause
#
cmake_minimum_required(VERSION 3.20.0)

find_package(Zephyr REQUIRED HINTS $ENV{ZEPHYR_BASE})
project(ExternalTelemetryUnit)

set(WPS_RADIO_COUNT 1)
set(APP "Cortical Implant")
set(HARDWARE "NRF")
set(MYPL "COORD") #Change between COORD or NODE for appropriate UWB device
set(NRF_HW_CONGIG_PATH ${CMAKE_CURRENT_SOURCE_DIR}/src CACHE PATH "Path to the configuration file for the nrf hardware")

message("Generating build : ${MYPL}")

# NORDIC SDK APP START
target_sources(app 
  PRIVATE
    src/main.c
  PUBLIC
    src/hw_cfg.h
)

add_subdirectory(lib/spark_sdk_v1.3.0)
add_subdirectory(lib/usb_console)
add_subdirectory(lib/INA231)

# Include application events and configuration headers
zephyr_library_include_directories(
  lib/spark_sdk_v1.3.0
  lib/usb_console
  lib/INA231
  ${NRF_HW_CONGIG_PATH}
  ${CORTICAL_IMPLANT_PATH}
)


target_link_libraries(app 
  PRIVATE
    cortical_implant
#  PUBLIC
#    hardware
)

# NORDIC SDK APP END
zephyr_library_include_directories(.)
```

## sample.yaml
```
sample:
  description: Code for UdeS GRAMS External telemetry unit
  name: External Telemetry Unit
tests:
  sample.bluetooth.peripheral_hr_coded:
    build_only: true
    integration_platforms:
      - nrf52840_custom
    platform_allow: nrf52840_custom
    tags: bluetooth ci_build
```

## prj.conf
```kconfig
#
# Copyright (c) 2020 Nordic Semiconductor
#
# SPDX-License-Identifier: LicenseRef-Nordic-5-Clause
#

#BLE PARAMAETERS
#CONFIG_NCS_SAMPLES_DEFAULTS=y
CONFIG_DK_LIBRARY=y

CONFIG_BT=y
CONFIG_BT_DEBUG_LOG=y
CONFIG_BT_PERIPHERAL=y
CONFIG_BT_DEVICE_NAME="External_Telemetry_Unit"
CONFIG_BT_BAS=y
CONFIG_BT_HRS=y

CONFIG_BT_CTLR_PHY_CODED=y
CONFIG_BT_CTLR_ADV_EXT=y

CONFIG_BT_EXT_ADV=y
CONFIG_BT_USER_PHY_UPDATE=y

#USB PARAMETER
CONFIG_USB_DEVICE_STACK=y
CONFIG_USB_DEVICE_PRODUCT="External Telemetry Unit"
CONFIG_USB_DEVICE_PID=0x0001
CONFIG_USB_DEVICE_VID=0x0001
CONFIG_USB_DEVICE_INITIALIZE_AT_BOOT=n

#CONFIG_USB_DEVICE_LOG_LEVEL_OFF=y

CONFIG_SERIAL=y
CONFIG_CONSOLE=y
CONFIG_UART_CONSOLE=y
CONFIG_UART_LINE_CTRL=y
CONFIG_UART_ASYNC_API=y

CONFIG_SPI=y
CONFIG_SPI_ASYNC=y

CONFIG_STDOUT_CONSOLE=y

CONFIG_DYNAMIC_INTERRUPTS=y

CONFIG_WATCHDOG=n
CONFIG_HEAP_MEM_POOL_SIZE=200000 
#232000

CONFIG_NRFX_TIMER0=y

# CONFIG_ZERO_LATENCY_IRQS=y
```

## src/main.c
```c
/*
 * Copyright (c) 2020 Nordic Semiconductor ASA
 *
 * SPDX-License-Identifier: LicenseRef-Nordic-5-Clause
 */

/** @file
 *  @brief Peripheral Heart Rate over LE Coded PHY sample
 */
#include "cortical_implant_coord.h"		//Choose this .h if in COORD mode in the CMAKE
// #include "cortical_implant_node.h" 	//Choose this .h if in NODE mode in the CMAKE
#include <nrfx_log.h>
// #include "pairing_basic_node.h"		//Keep commented
// #include "pairing_basic_coord.h"		//Keep commented
#include "hw_cfg.h"
#include "INA231.h"
#include "usb_console.h"

/* Private function prototype ************************************************/

/* INA I2C DEVICES ************************************************************/
static const struct i2c_dt_spec dev_ina_MCU = I2C_DT_SPEC_GET(DT_NODELABEL(ina_mcu));
static const struct i2c_dt_spec dev_ina_UWB = I2C_DT_SPEC_GET(DT_NODELABEL(ina_uwb));
static const struct i2c_dt_spec dev_ina_uSD = I2C_DT_SPEC_GET(DT_NODELABEL(ina_usd));
static const struct i2c_dt_spec dev_ina_5V = I2C_DT_SPEC_GET(DT_NODELABEL(ina_5v));

void show_data_ina23x(struct ina23x_data *ina1);
void init_all_ina23x(struct ina23x_data *ina1,struct ina23x_data *ina2,
	struct ina23x_data *ina3,struct ina23x_data *ina4);


/* BLE related prototype ****************************************************************/
static const struct bt_data ad[] = {
	BT_DATA_BYTES(BT_DATA_FLAGS, (BT_LE_AD_GENERAL | BT_LE_AD_NO_BREDR)),
	BT_DATA_BYTES(BT_DATA_UUID16_ALL,
		      BT_UUID_16_ENCODE(BT_UUID_HRS_VAL),
		      BT_UUID_16_ENCODE(BT_UUID_BAS_VAL),
		      BT_UUID_16_ENCODE(BT_UUID_DIS_VAL))
};

static void connected(struct bt_conn *conn, uint8_t err);
static void disconnected(struct bt_conn *conn, uint8_t reason);

BT_CONN_CB_DEFINE(conn_callbacks) = {
	.connected = connected,
	.disconnected = disconnected,
};

static void bt_ready(void);
static void auth_cancel(struct bt_conn *conn);

static struct bt_conn_auth_cb auth_cb_display = {
	.cancel = auth_cancel,
};

static void bas_notify(void);
static void hrs_notify(void);
/* END of BLE realted prototype *********************************************************/

int main(void)
{
	uint32_t err;
	uint32_t led_status = 0;
	struct ina23x_data ina_MCU = {dev_ina_MCU};
	struct ina23x_data ina_UWB = {dev_ina_UWB};
	struct ina23x_data ina_uSD = {dev_ina_uSD};
	struct ina23x_data ina_5V = {dev_ina_5V};
	if (!gpio_is_ready_dt(&led0) & !gpio_is_ready_dt(&led1) & !gpio_is_ready_dt(&led2) & !gpio_is_ready_dt(&led3) & !gpio_is_ready_dt(&led4) & !gpio_is_ready_dt(&uwb_irq_pin))
	{
		return 0;
	}

	gpio_pin_configure_dt(&led0, GPIO_OUTPUT_INACTIVE);
	gpio_pin_configure_dt(&led1, GPIO_OUTPUT_INACTIVE);
	gpio_pin_configure_dt(&led2, GPIO_OUTPUT_INACTIVE);
	gpio_pin_configure_dt(&led3, GPIO_OUTPUT_INACTIVE);
	gpio_pin_configure_dt(&led4, GPIO_OUTPUT_INACTIVE);

	err = enable_usb_console();
	if (err)
	{
		printk("USB enabling failed (err %d)\n", err);
		return 0;
	}

	err = dk_leds_init();
	if (err)
	{
		printk("LEDs init allo failed (err %d)\n", err);
		return 0;
	}
	// Initializing all ina231 before use and power down them.
	init_all_ina23x(&ina_MCU, &ina_UWB, &ina_uSD, &ina_5V);

	iface_tx_conn_status();
    iface_delay(500);
    iface_rx_conn_status();
    iface_delay(500);
    iface_rx_conn_status();
    iface_delay(500);
    iface_tx_conn_status();

	init_cortical_implant();

	/* BLE code *******************************************/
	printk("Starting Bluetooth Peripheral HR coded example\n");
	err = bt_enable(NULL);
	if (err) {
		printk("Bluetooth init failed (err %d)\n", err);
		return 0;
	}

	bt_ready();

	//bt_conn_auth_cb_register(&auth_cb_display);
	/*******************************************************/

	for (;;)
	{
		cortical_implant_routine();

		printk(GRN"***********************************************************************************\n");
		show_data_ina23x(&ina_MCU);
		show_data_ina23x(&ina_UWB);
		show_data_ina23x(&ina_uSD);
		show_data_ina23x(&ina_5V);
		printk(GRN"***********************************************************************************\n"NRM);

		/* Heartrate measurements simulation */
		hrs_notify();
		/* Battery level simulation */
		bas_notify();

		unpair_device();
		k_sleep(K_MSEC(100));
	}

	return 0;
}

/* Private function ***********************************************************/
void init_all_ina23x(struct ina23x_data *ina1,struct ina23x_data *ina2,
	struct ina23x_data *ina3,struct ina23x_data *ina4)
{
	int err = 0;
	// ina23x initialisation if available
	if (ina23x_available(ina1)){
		err += ina23x_init(ina1, 30000, 10);
		err += ina23x_alert_enable_set(ina1, INA231_CONVERSION_READY_BIT, 0, 0);
	}else{
		printk("ina23x MCU enabling failed (err %d)\n", err);
	}
	if (ina23x_available(ina2)){
		err += ina23x_init(ina2, 30000, 10);
		err += ina23x_alert_enable_set(ina2, INA231_CONVERSION_READY_BIT, 0, 0);
	}else{
		printk("ina23x UWB enabling failed (err %d)\n", err);
	}
	if (ina23x_available(ina3)){
		err += ina23x_init(ina3, 30000, 10);
		err += ina23x_alert_enable_set(ina3, INA231_CONVERSION_READY_BIT, 0, 0);
	}else{
		printk("ina23x uSD enabling failed (err %d)\n", err);
	}
	if (ina23x_available(ina4)){
		err += ina23x_init(ina4, 30000, 50);
		err += ina23x_alert_enable_set(ina4, INA231_CONVERSION_READY_BIT, 0, 0);
	}else{
		printk("ina23x 5V enabling failed (err %d)\n", err);
	}

	// Power down to save energy while not in use
	if(!ina23x_power_down(ina1)){
		printk("Error in ina231 power down (ina@%x!\n",ina1->devSpec.addr);
	}
	if(!ina23x_power_down(ina2)){
		printk("Error in ina231 power down (ina@%x!\n",ina2->devSpec.addr);
	}
		if(!ina23x_power_down(ina3)){
		printk("Error in ina231 power down (ina@%x!\n",ina3->devSpec.addr);
	}
		if(!ina23x_power_down(ina4)){
		printk("Error in ina231 power down (ina@%x!\n",ina4->devSpec.addr);
	}

	if (err){
		printk(RED"Error in ina231 initialization !\n"NRM);
	}else{
		printk(NRM"All ina231 initialized !\n");
	}
}

void show_data_ina23x(struct ina23x_data *ina1){
	int err = 0;
	int tempCurrent = 0;
	int tempBus = 0;
	int tempPower = 0;

	// Power up before reading
	ina23x_power_up(ina1);

	// Read current, Bus voltage and power and print the values
	err += ina23x_format_read(ina1,INA23X_CURRENT,&tempCurrent);
	err += ina23x_format_read(ina1,INA23X_POWER,&tempPower);
	err += ina23x_format_read(ina1,INA23X_BUS_VOLTAGE,&tempBus);

	if(err){
		printk("Error showing the data (ina@%x)", ina1->devSpec.addr);
		// Power down to save energy
		ina23x_power_down(ina1);
	}else{
		switch(ina1->devSpec.addr){
		case 0x40:
			printk(GRN"ina@MCU : "NRM);
			break;
		case 0x41:
			printk(GRN"ina@UWB : "NRM);
			break;
		case 0x44:
			printk(GRN"ina@uSD : "NRM);
			break;
		case 0x45:
			printk(GRN"ina@5V  : "NRM);
			break;
		default:
			printk(YEL"ina@%x : "NRM, ina1->devSpec.addr);
			break;
		}
		printk("Bus voltage = %i mV || Current = %i uA \t|| Power = %i uW\n", tempBus, tempCurrent, tempPower);
	}

	// Power down after reading to save energy
	ina23x_power_down(ina1);
}

/* Bluetooth related functions *************************************************/

static void connected(struct bt_conn *conn, uint8_t err)
{
	if (err) {
		printk("Connection failed (err 0x%02x)\n", err);
	} else {
		printk("Connected\n");
	}
}

static void disconnected(struct bt_conn *conn, uint8_t reason)
{
	printk("Disconnected (reason 0x%02x)\n", reason);
}

static void bt_ready(void)
{
	int err;

	printk("Bluetooth initialized\n");

	err = bt_le_adv_start(BT_LE_ADV_CONN_NAME, ad, ARRAY_SIZE(ad), NULL, 0);
	if (err) {
		printk("Advertising failed to start (err %d)\n", err);
		return;
	}

	printk("Advertising successfully started\n");
}

static void auth_cancel(struct bt_conn *conn)
{
	char addr[BT_ADDR_LE_STR_LEN];

	bt_addr_le_to_str(bt_conn_get_dst(conn), addr, sizeof(addr));

	printk("Pairing cancelled: %s\n", addr);
}

static void bas_notify(void)
{
	uint8_t battery_level = bt_bas_get_battery_level();

	battery_level--;

	if (!battery_level) {
		battery_level = 100U;
	}

	bt_bas_set_battery_level(battery_level);
}

static void hrs_notify(void)
{
	static uint8_t heartrate = 90U;

	/* Heartrate measurements simulation */
	heartrate++;
	if (heartrate == 160U) {
		heartrate = 90U;
	}

	bt_hrs_notify(heartrate);
}
```

## src/hw_cfg.h
```c
#ifndef HW_CFG_H_
#define HW_CFG_H_

#include <dk_buttons_and_leds.h>
#include <stddef.h>
#include <string.h>
#include <errno.h>
#include <zephyr/kernel.h>
#include <zephyr/types.h>
#include <zephyr/drivers/i2c.h>
#include <zephyr/drivers/gpio.h>
#include <zephyr/drivers/spi.h>
#include <zephyr/device.h>
#include <zephyr/sys/printk.h>
// Bluetooth HEADER files
#include <zephyr/bluetooth/bluetooth.h>
#include <zephyr/bluetooth/hci.h>
#include <zephyr/bluetooth/conn.h>
#include <zephyr/bluetooth/uuid.h>
#include <zephyr/bluetooth/gatt.h>
#include <zephyr/bluetooth/services/bas.h>
#include <zephyr/bluetooth/services/hrs.h>


#define DEVICE_NAME             CONFIG_BT_DEVICE_NAME
#define DEVICE_NAME_LEN         (sizeof(DEVICE_NAME) - 1)

#define RUN_STATUS_LED          0
#define CON_STATUS_LED          1
#define REC_STATUS_LED          2
#define RUN_LED_BLINK_INTERVAL  1000
#define NOTIFY_INTERVAL         1000

/* *********************************************** */
/************** GPIO CONGIGURATION *****************/

/* Outputs */

/* The devicetree node identifier for the GPIOS alias. */
#define LED0_NODE           DT_ALIAS(led0)
#define LED1_NODE           DT_ALIAS(led1)
#define LED2_NODE           DT_ALIAS(led2)
#define LED3_NODE           DT_ALIAS(led3)
#define LED4_NODE           DT_ALIAS(led4)
#define UWB_SHTDWN_NODE     DT_NODELABEL(uwb_shutdown)
#define UWB_RESET_NODE      DT_NODELABEL(uwb_reset)
#define UWB_CS_NODE			DT_NODELABEL(uwb_cs)
/* GPIOs spec structure containing the configuration. */
/* Arguments of functions named : gpio_pin_XXX_dt() */
static const struct gpio_dt_spec led0          	 	= GPIO_DT_SPEC_GET(LED0_NODE, gpios);
static const struct gpio_dt_spec led1          	 	= GPIO_DT_SPEC_GET(LED1_NODE, gpios);
static const struct gpio_dt_spec led2          	 	= GPIO_DT_SPEC_GET(LED2_NODE, gpios);
static const struct gpio_dt_spec led3          	 	= GPIO_DT_SPEC_GET(LED3_NODE, gpios);
static const struct gpio_dt_spec led4          	 	= GPIO_DT_SPEC_GET(LED4_NODE, gpios);
static const struct gpio_dt_spec uwb_shutdown_pin   = GPIO_DT_SPEC_GET(UWB_SHTDWN_NODE, gpios);
static const struct gpio_dt_spec uwb_reset_pin      = GPIO_DT_SPEC_GET(UWB_RESET_NODE, gpios);

/* Inputs */

/* The devicetree node identifier for the GPIOS alias. */
#define UWB_IRQ_NODE DT_ALIAS(uwb_irq)

/* GPIOs spec structure containing the configuration. */
/* To use with function named : gpio_pin_XXX_dt() */
static const struct gpio_dt_spec uwb_irq_pin    = GPIO_DT_SPEC_GET(UWB_IRQ_NODE, gpios);

/* *********************************************** */

#define SPI_UWB_NODE 		DT_NODELABEL(spi3)
#define SPI_UWB_OPERATION 	SPI_OP_MODE_MASTER | SPI_WORD_SET(8) | SPI_TRANSFER_MSB

static const struct device *const uwb_spi_dev = DEVICE_DT_GET(SPI_UWB_NODE);


// static struct spi_dt_spec uwb_spi_dev = SPI_CONFIG_DT(SPI_UWB_NODE, SPI_UWB_OPERATION, 0);


static struct spi_cs_control uwb_cs_ctrl = (struct spi_cs_control){
		.gpio = GPIO_DT_SPEC_GET(UWB_CS_NODE, gpios),
		.delay = 0u,
};

// static struct spi_cs_control uwb_cs_ctrl = (struct spi_cs_control){
// 		.gpio = GPIO_DT_SPEC_GET(SPI_UWB_NODE, cs_gpios),
// 		.delay = 0u,
// };

#define NRM  "\x1B[0m"
#define RED  "\x1B[31m"
#define GRN  "\x1B[32m"
#define YEL  "\x1B[33m"
#define BLU  "\x1B[34m"
#define MAG  "\x1B[35m"
#define CYN  "\x1B[36m"
#define WHT  "\x1B[37m"



/* IRQ Lines */
//#define PEND_SV_IRQ 		20

/* Priorities */
//#define PRIO_PEND_SV_IRQ	2


#endif // HW_CFG_H_
```
